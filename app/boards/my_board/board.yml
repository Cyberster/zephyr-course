## app/boards/my_board/board.yml
```yaml
board:
  name: my_board
  full_name: My Board From Scratch
  vendor: my_vendor
  socs:
    - name: stm32f411xe
```

## app/boards/our_board/Kconfig.defconfig
```kconfig
# Copyright (c) 2020 Brian Bradley
# SPDX-License-Identifier: Apache-2.0

# F411CE based Black Pill V2.0+ board board configuration

if BOARD_OUR_BOARD

config SPI_STM32_INTERRUPT
	default y
	depends on SPI

endif # BOARD_OUR_BOARD
```

## app/boards/our_board/board.yml
```yaml
board:
  name: our_board
  full_name: Our Board
  vendor: our_vendor
  socs:
    - name: stm32f411xe
```
